## configs/nano5g_defconfig
```kconfig
CONFIG_ARM=y
CONFIG_POSITION_INDEPENDENT=y
CONFIG_ARCH_S5L87XX=y
CONFIG_TEXT_BASE=0x22000000
CONFIG_DEFAULT_DEVICE_TREE="s5l8730"
CONFIG_TARGET_NANO5G=y
CONFIG_DEBUG_UART_BASE=0x3CC00000
CONFIG_DEBUG_UART_CLOCK=140000000
CONFIG_DEBUG_UART_BOARD_INIT=y
CONFIG_SYS_LOAD_ADDR=0x08000000
CONFIG_DEBUG_UART=y
CONFIG_LOCALVERSION="q3k"
# CONFIG_ANDROID_BOOT_IMAGE is not set
# CONFIG_SYS_DEVICE_NULLDEV is not set
CONFIG_OF_CONTROL=y
CONFIG_USB_FUNCTION_FASTBOOT=y
CONFIG_FASTBOOT_BUF_ADDR=0xdeadbeef
CONFIG_SERIAL_SEARCH_ALL=y
CONFIG_DEBUG_UART_ANNOUNCE=y
CONFIG_USB=y
CONFIG_DM_USB_GADGET=y
CONFIG_USB_GADGET=y
CONFIG_USB_GADGET_MANUFACTURER="lmao"
CONFIG_USB_GADGET_VENDOR_NUM=0x1209
CONFIG_USB_GADGET_PRODUCT_NUM=0x2137
CONFIG_USB_GADGET_DWC2_OTG=y
CONFIG_USB_FUNCTION_SDP=y
CONFIG_USB_FUNCTION_ACM=y
CONFIG_USB_ETHER=y
CONFIG_USB_ETH_CDC=y
```
